#include <WiFi.h>
#include <ESPAsyncWebServer.h>
#include <Wire.h>
#include <VL53L0X.h>
#include "smart_wifi.h"
#include "esp_camera.h"
#include <esp_task_wdt.h>
#include <People_inferencing.h>
#include "edge-impulse-sdk/classifier/ei_run_classifier.h"

// --- THE FIX: FORCE AI MATH INTO FAST INTERNAL RAM ---
#define EI_CLASSIFIER_ALLOCATION_STATIC 1

// --- Camera Pins (XIAO ESP32S3 Sense) ---
#define PWDN_GPIO_NUM     -1
#define RESET_GPIO_NUM    -1
#define XCLK_GPIO_NUM     10
#define SIOD_GPIO_NUM     40
#define SIOC_GPIO_NUM     39
#define Y9_GPIO_NUM       48
#define Y8_GPIO_NUM       11
#define Y7_GPIO_NUM       12
#define Y6_GPIO_NUM       14
#define Y5_GPIO_NUM       16
#define Y4_GPIO_NUM       18
#define Y3_GPIO_NUM       17
#define Y2_GPIO_NUM       15
#define VSYNC_GPIO_NUM    38
#define HREF_GPIO_NUM     47
#define PCLK_GPIO_NUM     13

// --- TOUCH SENSOR VARIABLES ---
#define TOUCH_PIN 1 // gpio1
volatile bool system_active = false;
bool last_touch_state = LOW;

volatile uint16_t current_distance = 0;

AsyncWebServer server(80);
VL53L0X tof; //  ToF variable

String tof_status   = "Init..."; // ToF
String cam_status   = "Init..."; // Camera
String ai_result    = "Waiting..."; // Image Recognition

// Buffer for AI
uint8_t* snapshot_buf = nullptr;

// --- Edge Impulse Callback --- Generated by the Edge-impulse and arduino
int ei_camera_get_data(size_t offset, size_t length, float *out_ptr) {
    size_t pixel_ix = offset * 3;
    size_t bytes_left = length;
    size_t out_ptr_ix = 0;
    while (bytes_left != 0) {
        uint32_t packed_rgb = ((uint32_t)snapshot_buf[pixel_ix] << 16) | 
                              ((uint32_t)snapshot_buf[pixel_ix + 1] << 8) | 
                              (uint32_t)snapshot_buf[pixel_ix + 2];
        out_ptr[out_ptr_ix] = (float)packed_rgb;
        out_ptr_ix++;
        pixel_ix += 3;
        bytes_left--;
    }
    return 0;
}

// --- Global Task Handle for AI ---
TaskHandle_t AITaskHandle;

void aiTask(void * pvParameters) {     //core 0 touch sensor infinite loop
    for(;;) {

        // ==========================================
        // THE MASTER KILL SWITCH - TOUCH SENSOR
        // ==========================================
        if (!system_active) {
            ai_result = "System Paused (Touch to Activate)";
            vTaskDelay(500 / portTICK_PERIOD_MS);
            continue;
        }
        // ==========================================

        current_distance = tof.readRangeContinuousMillimeters();
        if (tof.timeoutOccurred()) { current_distance = 2000; } 

        // TRIGGERS BETWEEN 1mm AND 1000mm
        if (current_distance > 0 && current_distance < 1000 && cam_status == "Online") {
            
            // ==========================================
            // 1. PRE-EMPTIVE PROXIMITY ALERT
            // ==========================================
            if (current_distance <= 300) { // Setting the "Danger Zone" here (e.g., 30cm)
                ai_result = "IMMINENT COLLISION";
                vTaskDelay(150 / portTICK_PERIOD_MS);
            } else {
                ai_result = "Analyzing object...";
            }
            
            // CRUCIAL: We must pause Core 1 for 300ms. This gives the Web Server 
            // on Core 0 enough time to serve the new Warning text to the browser 
            // BEFORE we freeze Core 1 with heavy AI math!
            //vTaskDelay(300 / portTICK_PERIOD_MS); 
            // ==========================================

            
            // ==========================================
            // 2. CAPTURE AND PROCESS AI
            // ==========================================
            unsigned long start_time = millis(); 
            
            camera_fb_t *fb = esp_camera_fb_get();
            if (fb) {
                unsigned long conv_start = millis();
                fmt2rgb888(fb->buf, fb->len, fb->format, snapshot_buf);
                esp_camera_fb_return(fb); 
                unsigned long conv_time = millis() - conv_start;
                
                ei::signal_t signal;
                signal.total_length = EI_CLASSIFIER_INPUT_WIDTH * EI_CLASSIFIER_INPUT_HEIGHT;
                signal.get_data = &ei_camera_get_data;
                
                ei_impulse_result_t result = { 0 };
                
                unsigned long ai_start = millis();
                EI_IMPULSE_ERROR err = run_classifier(&signal, &result, false);
                unsigned long ai_time = millis() - ai_start;
                
                if (err == EI_IMPULSE_OK) {
                    float highest_score = 0.0;
                    String highest_label = "None";

#if EI_CLASSIFIER_OBJECT_DETECTION == 1
                    for (uint32_t i = 0; i < result.bounding_boxes_count; i++) {
                        if (result.bounding_boxes[i].value > highest_score) {
                            highest_score = result.bounding_boxes[i].value;
                            highest_label = String(result.bounding_boxes[i].label);
                        }
                    }
                    if (result.bounding_boxes_count == 0) highest_label = "No Objects Found";
#else
                    for (uint16_t i = 0; i < EI_CLASSIFIER_LABEL_COUNT; i++) {
                        if (result.classification[i].value > highest_score && String(ei_classifier_inferencing_categories[i]) != "background") {
                            highest_score = result.classification[i].value;
                            highest_label = String(ei_classifier_inferencing_categories[i]);
                        }
                    }
#endif
                    // Update the final string with what the object actually was                    
                    ai_result = highest_label + " (" + String(highest_score) + ") | Math: " + String(ai_time) + "ms";
                    Serial.println("Total Time: " + String(millis() - start_time) + "ms | Conv: " + String(conv_time) + "ms | AI: " + String(ai_time) + "ms");
                }
            }
            vTaskDelay(600 / portTICK_PERIOD_MS); 
            
        } else {
            // THE FIX: If distance is 0, or > 1000, we ALWAYS hit this block now.
            ai_result = "Waiting for object...";
            vTaskDelay(100 / portTICK_PERIOD_MS); 
        }
        
        taskYIELD(); 
    }
}
// Start of the entire system
void setup() {
    // Force the Wi-Fi stack to stay on Core 0
    xTaskCreatePinnedToCore(
        [](void*){ for(;;){ delay(1000); } }, // Dummy task
        "Idle", 10000, NULL, 1, NULL, 0
    );

    Serial.begin(115200);    
    delay(2000); 

    pinMode(TOUCH_PIN, INPUT);

    esp_task_wdt_delete(NULL); 

    // ==========================================
    // Core 0 - Activity 1 - SMART WIFI CONNECTION
    // ==========================================
    setupSmartWiFi();
    // ==========================================

    // ==========================================
    // Core 1 - Activity 1 -  TOF INIT
    // ==========================================
    Serial.println("Attempting ToF Init...");
    
    Wire.begin(5, 6);// using the default I2C pins (SDA = 5 (gpio5), SCL = 6(gpio6))
    
    Serial.print("I2C Scanner: ");
    int nDevices = 0;
    for(byte address = 1; address < 127; address++ ) {
        Wire.beginTransmission(address);
        if (Wire.endTransmission() == 0) {
            Serial.print("Found device at 0x");
            Serial.print(address, HEX);
            Serial.print("  ");
            nDevices++;
        }
    }
    if (nDevices == 0) {
        Serial.println("NO DEVICES FOUND! Check physical wiring.");
    } else {
        Serial.println();
    }
    
    tof_status = "FAILED"; // Default to failed
    for(int i = 0; i < 5; i++) {
        if (tof.init()) { 
            tof_status = "Online"; 
            tof.setTimeout(500);
            tof.startContinuous(); 
            break; 
        }
        delay(200);
    }
    Serial.println("ToF Init finished. Status: " + tof_status);

    // ==========================================
    // Core 1 - Activity 2 - CAMERA INIT
    // ==========================================
    Serial.println("Attempting Camera Init...");
    camera_config_t config;
    config.pin_d0 = Y2_GPIO_NUM; config.pin_d1 = Y3_GPIO_NUM;
    config.pin_d2 = Y4_GPIO_NUM; config.pin_d3 = Y5_GPIO_NUM;
    config.pin_d4 = Y6_GPIO_NUM; config.pin_d5 = Y7_GPIO_NUM;
    config.pin_d6 = Y8_GPIO_NUM; config.pin_d7 = Y9_GPIO_NUM;
    config.pin_xclk = XCLK_GPIO_NUM; config.pin_pclk = PCLK_GPIO_NUM;
    config.pin_vsync = VSYNC_GPIO_NUM; config.pin_href = HREF_GPIO_NUM;
    config.pin_sccb_sda = SIOD_GPIO_NUM; config.pin_sccb_scl = SIOC_GPIO_NUM;
    config.pin_pwdn = PWDN_GPIO_NUM;
    config.pin_reset = RESET_GPIO_NUM;
    
    config.xclk_freq_hz = 10000000;
    config.pixel_format = PIXFORMAT_RGB565;
    config.frame_size = FRAMESIZE_96X96;
    config.fb_location = CAMERA_FB_IN_PSRAM;
    config.fb_count = 2; 
    //config.grab_mode = CAMERA_GRAB_WHEN_EMPTY;
    config.grab_mode = CAMERA_GRAB_LATEST;

    if (esp_camera_init(&config) == ESP_OK) {
        cam_status = "Online";
        snapshot_buf = (uint8_t*)malloc(EI_CLASSIFIER_INPUT_WIDTH * EI_CLASSIFIER_INPUT_HEIGHT * 3);
    } else {
        cam_status = "FAILED";
    }
    Serial.println("Camera Init finished. Status: " + cam_status);

    // ==========================================
    // Core 1 - Activity 3 - START AI Task (Camera + Image/Object Identification)
    // ==========================================

    /*
    function xTaskCreatePinnedToCore
        → BaseType_t
        Parameters:

        TaskFunction_t pvTaskCode
        const char *const pcName
        const uint32_t usStackDepth
        void *const pvParameters
        UBaseType_t uxPriority
        TaskHandle_t *const pvCreatedTask
        const BaseType_t xCoreID
    */
    BaseType_t taskSpawned = xTaskCreatePinnedToCore(aiTask, "AITask", 10240, NULL, 1, &AITaskHandle, 1);
    
    // Safety check so we are never blind to task crashes again
    if (taskSpawned != pdPASS) {
        ai_result = "ERROR: Out of Memory!";
        Serial.println("FATAL: AI Task failed to spawn!");
    }

    // ==========================================
    // Core 0 - Web Server & AI Dashboard (The below web page will be pushed on to the client, and regularly updated.)
    // ==========================================

    server.on("/", HTTP_GET, [](AsyncWebServerRequest *request){
        String html = R"rawliteral(
        <!DOCTYPE HTML><html>
        <head>
            <meta charset="UTF-8">
            <meta name="viewport" content="width=device-width, initial-scale=1">
            <title>NaviSense</title>
            <style>
                body { font-family: Arial, sans-serif; margin: 40px; background-color: #121212; color: #ffffff; overflow: hidden; }
                h1 { color: #00ff88; }
                .status { font-size: 1.2em; margin-bottom: 10px; }
                .ai-box { background-color: #1e1e1e; padding: 20px; border-radius: 10px; border-left: 5px solid #00ff88; margin-top: 20px;}
                
                /* THE NEW FULL-SCREEN UNLOCK OVERLAY */
                #unlock-screen {
                    position: fixed; top: 0; left: 0; width: 100%; height: 100%;
                    background-color: rgba(18, 18, 18, 0.95); z-index: 9999;
                    display: flex; flex-direction: column; justify-content: center; align-items: center;
                }
                .start-btn {
                    padding: 20px 40px; font-size: 24px; background-color: #00ff88;
                    color: #121212; border: none; border-radius: 10px; cursor: pointer; font-weight: bold;
                    box-shadow: 0px 5px 15px rgba(0, 255, 136, 0.4);
                }
                .start-btn:active { background-color: #00cc6a; transform: scale(0.95); }
            </style>
            <script>
                let lastSpoken = "";
                let synth = window.speechSynthesis;
                let currentUtterance = null;
                let audioUnlocked = false;

                // --- THE AUDIO UNLOCKER FUNCTION ---
                function unlockAudio() {
                    audioUnlocked = true;
                    // Speak a welcome message to confirm it works
                    let welcome = new SpeechSynthesisUtterance("Audio active. NaviSense online.");
                    synth.speak(welcome);
                    
                    // Hide the overlay and restore scrolling
                    document.getElementById("unlock-screen").style.display = "none";
                    document.body.style.overflow = "auto";
                }

                function safeSpeak(text, isEmergency) {
                    if (!audioUnlocked) return; // Don't try to speak if locked

                    if (isEmergency) {
                        synth.cancel(); 
                    } else if (synth.speaking || synth.pending) {
                        return; 
                    }

                    setTimeout(() => {
                        currentUtterance = new SpeechSynthesisUtterance(text);
                        currentUtterance.rate = 1.1; 
                        synth.speak(currentUtterance);
                    }, isEmergency ? 100 : 0);
                }

                function updateData() {
                    fetch('/data')
                        .then(response => response.json())
                        .then(data => {
                            document.getElementById("tof").innerText = data.tof;
                            document.getElementById("cam").innerText = data.cam;
                            document.getElementById("ai").innerText = data.ai;
                            document.getElementById("dist").innerText = data.dist + " mm";
                            
                            let currentAI = data.ai;
                            
                            if (currentAI.includes("Paused")) {
                                if (lastSpoken !== "Paused") {
                                    synth.cancel();
                                    lastSpoken = "Paused";
                                }
                                return;
                            }
                            
                            if (currentAI.includes("Analyzing") || currentAI.includes("Waiting") || currentAI.includes("No Objects")) {
                                return;
                            }
                            
                            if (currentAI !== lastSpoken) {
                                lastSpoken = currentAI;
                                
                                if (currentAI.includes("COLLISION")) {
                                    safeSpeak("Warning! Obstruction at " + data.dist + " millimeters!", true);
                                } else {
                                    let cleanName = currentAI.split("(")[0].trim(); 
                                    safeSpeak(cleanName + " identified.", false);
                                }
                            }
                        })
                        .catch(err => console.log("Network Error"));
                }
                
                setInterval(updateData, 400); 
            </script>
        </head>
        <body onload="updateData()">
            
            <!-- THE START OVERLAY -->
            <div id="unlock-screen">
                <h2 style="color: white; margin-bottom: 30px;">Browser Audio Locked</h2>
                <button class="start-btn" onclick="unlockAudio()">Tap to Start NaviSense</button>
            </div>

            <h1>NaviSense Dashboard</h1>
            
            <div class="status">ToF Sensor: <span id="tof">Loading...</span></div>
            <div class="status">Camera: <span id="cam">Loading...</span></div>
            <div class="status">Distance: <span id="dist">Loading...</span></div>
            
            <div class="ai-box">
                <h2>AI Status: <span id="ai">Loading...</span></h2>
            </div>
        </body>
        </html>
        )rawliteral";
        
        request->send(200, "text/html", html);
    });

    server.on("/data", HTTP_GET, [](AsyncWebServerRequest *request){
        String json = "{";
        json += "\"tof\":\"" + tof_status + "\",";
        json += "\"cam\":\"" + cam_status + "\",";
        json += "\"ai\":\"" + ai_result + "\",";
        json += "\"dist\":" + String(current_distance);
        json += "}";
        request->send(200, "application/json", json);
    });
    server.begin();
}

void loop() {
    bool current_touch = digitalRead(TOUCH_PIN);
    
    // The sensor hardware remembers the toggle state, so we just copy it directly!
    system_active = (current_touch == HIGH);
    
    // Only print to Serial when the switch is actually flipped
    if (current_touch != last_touch_state) {
        Serial.println(system_active ? "System ACTIVATED" : "System PAUSED");
        last_touch_state = current_touch;
    }
    
    // Very fast UI polling (50ms) - completely safe for FreeRTOS
    vTaskDelay(50 / portTICK_PERIOD_MS); 
}